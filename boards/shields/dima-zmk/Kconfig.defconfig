## boards/shields/dima-zmk/Kconfig.defconfig
```kconfig
# Copyright (c) 2022 The ZMK Contributors
# SPDX-License-Identifier: MIT

if SHIELD_DIMA-ZMK_LEFT

config ZMK_KEYBOARD_NAME
    default "Dima-ZMK"
    
config ZMK_SPLIT_ROLE_CENTRAL
    default y

endif

if SHIELD_DIMA-ZMK_LEFT || SHIELD_DIMA-ZMK_RIGHT

config ZMK_SPLIT
    default y

endif
```

## boards/shields/dima-zmk/Kconfig.shield
```kconfig
config SHIELD_DIMA_ZMK
    bool "Dima ZMK Shield"
    depends on ZMK_KEYBOARD
    default y
```
